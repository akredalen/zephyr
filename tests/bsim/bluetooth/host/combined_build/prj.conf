## CMakeLists.txt
```
# SPDX-License-Identifier: Apache-2.0

cmake_minimum_required(VERSION 3.20.0)

find_package(Zephyr REQUIRED HINTS $ENV{ZEPHYR_BASE})
project(bsim_test_combined_build)

add_subdirectory(${ZEPHYR_BASE}/tests/bluetooth/common/testlib testlib)
target_link_libraries(app PRIVATE testlib)

add_subdirectory(${ZEPHYR_BASE}/tests/bsim/babblekit babblekit)
target_link_libraries(app PRIVATE babblekit)

target_sources(app PRIVATE
  src/_bsim_main.c
  src/l2cap_credits/main.c
  src/l2cap_credits/seg_recv_main.c
  src/l2cap_ecred/main.c
  src/l2cap_ecred/dut.c
  src/l2cap_ecred/peer.c
  src/l2cap_einprogress/main.c
  src/l2cap_einprogress/dut.c
  src/l2cap_einprogress/tester.c
  src/l2cap_general/ecred_main.c
  src/l2cap_many_conns/main.c
  src/l2cap_send_on_connect/main.c
  )

zephyr_include_directories(
  ${BSIM_COMPONENTS_PATH}/libUtilv1/src/
  ${BSIM_COMPONENTS_PATH}/libPhyComv1/src/
  )
```

## prj.conf
```kconfig
CONFIG_BT=y
CONFIG_BT_CENTRAL=y
CONFIG_BT_PERIPHERAL=y
CONFIG_BT_DEVICE_NAME_DYNAMIC=y

CONFIG_BT_EATT=n
CONFIG_BT_BONDABLE=y

CONFIG_BT_TESTING=y
CONFIG_BT_TESTING_CFG=y

## The following configurations must explicitly be set in-test when BT_TESTING_CFG is enabled.
CONFIG_BT_L2CAP_ECRED=y
CONFIG_BT_L2CAP_SEG_RECV=y

CONFIG_ASSERT=y
CONFIG_BT_EXT_ADV=y
CONFIG_LOG=y
CONFIG_THREAD_NAME=y
CONFIG_LOG_THREAD_ID_PREFIX=y
CONFIG_ARCH_POSIX_TRAP_ON_FATAL=y

CONFIG_LOG_FUNC_NAME_PREFIX_DBG=y
CONFIG_LOG_FUNC_NAME_PREFIX_INF=y
CONFIG_LOG_FUNC_NAME_PREFIX_WRN=y
CONFIG_LOG_FUNC_NAME_PREFIX_ERR=y

CONFIG_BT_SMP=y
CONFIG_BT_L2CAP_DYNAMIC_CHANNEL=y
CONFIG_BT_HCI_ACL_FLOW_CONTROL=y
CONFIG_BT_BUF_ACL_RX_SIZE=75

# Disable auto-initiated procedures so they don't
# mess with the test's execution.
CONFIG_BT_AUTO_PHY_UPDATE=n
CONFIG_BT_AUTO_DATA_LEN_UPDATE=n
CONFIG_BT_GAP_AUTO_UPDATE_CONN_PARAMS=n

CONFIG_BT_L2CAP_TX_MTU=1000
CONFIG_BT_BUF_ACL_TX_SIZE=81
CONFIG_BT_BUF_ACL_TX_COUNT=4
CONFIG_BT_BUF_ACL_RX_SIZE=81
CONFIG_BT_L2CAP_TX_BUF_COUNT=100
CONFIG_BT_CTLR_DATA_LENGTH_MAX=81
CONFIG_BT_CTLR_RX_BUFFERS=10

# Debugging
# CONFIG_BT_L2CAP_LOG_LEVEL_DBG=y

########## TESTING: Remove if not used #############
CONFIG_BT_MAX_CONN=4
CONFIG_NET_BUF_POOL_USAGE=y
```

## src/_bsim_main.c
```c
/*
 * Copyright (c) 2025 Nordic Semiconductor
 *
 * SPDX-License-Identifier: Apache-2.0
 */

#include "bstests.h"

extern struct bst_test_list *test_main_l2cap_credits_seg_recv_install(struct bst_test_list *tests);
extern struct bst_test_list *test_main_l2cap_credits_install(struct bst_test_list *tests);
extern struct bst_test_list *test_main_l2cap_send_on_connect_install(struct bst_test_list *tests);
extern struct bst_test_list *test_main_l2cap_einprogress_install(struct bst_test_list *tests);
extern struct bst_test_list *test_main_l2cap_general_ecred_install(struct bst_test_list *tests);
extern struct bst_test_list *test_main_l2cap_ecred_install(struct bst_test_list *tests);
extern struct bst_test_list *test_main_l2cap_many_conns_install(struct bst_test_list *tests);
// extern struct bst_test_list *test_main_l2cap_multilink_peripheral_install(struct bst_test_list *tests);

bst_test_install_t test_installers[] = {
        test_main_l2cap_credits_install,
        test_main_l2cap_credits_seg_recv_install,
        test_main_l2cap_send_on_connect_install,
        test_main_l2cap_einprogress_install,
        test_main_l2cap_general_ecred_install,
        test_main_l2cap_ecred_install,
        test_main_l2cap_many_conns_install,
        // test_main_l2cap_multilink_peripheral_install,
        NULL
};

int main(void)
{
	bst_main();

	return 0;
}
```
